## net/ntpsec/Config.in
```kconfig
menu "Configuration"
	depends on PACKAGE_ntpsecd

config NTPSEC_SECCOMP
	bool "Enable support for seccomp in NTPsec"
	default KERNEL_SECCOMP
	help
	  Build NTPsec with support for seccomp filters.
	  Select libseccomp which also pulls-in the needed kernel features.

choice
	prompt "Python version"
	default NTPSEC_PYTHON

	config NTPSEC_PYTHON
		bool "2"

	config NTPSEC_PYTHON3
		bool "3"
endchoice

endmenu
```

## utils/gpsd/Config.in
```kconfig
menu "Configuration"
	depends on (PACKAGE_gpsd || PACKAGE_gpsd-minimal || PACKAGE_gpsd-timeservice)

choice
	prompt "Python version"
	default GPSD_PYTHON

	config GPSD_PYTHON
		bool "2"

	config GPSD_PYTHON3
		bool "3"
endchoice

endmenu
```
